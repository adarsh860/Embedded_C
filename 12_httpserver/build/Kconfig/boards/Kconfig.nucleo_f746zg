## 12_httpserver/build/Kconfig/boards/Kconfig.nucleo_f746zg
```kconfig
# Load board Kconfig descriptions.
osource "C:/zephyrproject/zephyr/boards/st/nucleo_f746zg/Kconfig.nucleo_f746zg"
```

## 13_http_mqtt/build/Kconfig/boards/Kconfig
```kconfig
# Load Zephyr board Kconfig descriptions.
osource "C:/zephyrproject/zephyr/boards/st/nucleo_f746zg/Kconfig"
```

## 17_lora_rec/build/Kconfig/boards/Kconfig.defconfig
```kconfig
# Load Zephyr board defconfig descriptions.
osource "C:/zephyrproject/zephyr/boards/st/nucleo_f746zg/Kconfig.defconfig"
```

## 17_lora_rec/build/Kconfig/boards/Kconfig.sysbuild
```kconfig
# Load Sysbuild board Kconfig descriptions.
osource "C:/zephyrproject/zephyr/boards/st/nucleo_f746zg/Kconfig.sysbuild"
```

## 3_net_st/build/Kconfig/boards/Kconfig
```kconfig
# Load Zephyr board Kconfig descriptions.
osource "C:/zephyrproject/zephyr/boards/espressif/esp32_devkitc/Kconfig"
```

## 3_net_st/build/Kconfig/boards/Kconfig.defconfig
```kconfig
# Load Zephyr board defconfig descriptions.
osource "C:/zephyrproject/zephyr/boards/espressif/esp32_devkitc/Kconfig.defconfig"
```

## 3_net_st/build/Kconfig/boards/Kconfig.esp32_devkitc
```kconfig
# Load board Kconfig descriptions.
osource "C:/zephyrproject/zephyr/boards/espressif/esp32_devkitc/Kconfig.esp32_devkitc"
```

## 3_net_st/build/Kconfig/boards/Kconfig.sysbuild
```kconfig
# Load Sysbuild board Kconfig descriptions.
osource "C:/zephyrproject/zephyr/boards/espressif/esp32_devkitc/Kconfig.sysbuild"
```
